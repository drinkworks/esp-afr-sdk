## components/DW/Kconfig.projbuild
```kconfig
menu "Drinkworks Configuration"

    config PROJECT_NAME
    string "Name of Project"
    default "dw_"
    help
        Override default project name (esp-idf). This gets built into Application
        
    config DW_RELEASE_BUILD
        bool "Release Build Configuration"
        default "y"
        help
            If this is not enabled, allow setting of individual settings.
            
    menu "Drinkworks Log Settings"
        depends on !DW_RELEASE_BUILD
    
        choice DW_LOG_APP_LEVEL
            bool "Drinkworks Firmware Application log verbosity"
            default DW_LOG_APP_NONE
            help
                Specify how much output to see in the Firmware Application logs.
    
                Note that this setting limits which log statements
                are compiled into the program. So setting this to, say,
                "Warning" would mean that changing log level to "Debug"
                at runtime will not be possible.
    
            config DW_LOG_APP_NONE
                bool "No output"
            config DW_LOG_APP_ERROR
                bool "Error"
            config DW_LOG_APP_WARN
                bool "Warning"
            config DW_LOG_APP_INFO
                bool "Info"
            config DW_LOG_APP_DEBUG
                bool "Debug"
        endchoice
        
        config DW_LOG_APP_LEVEL
            int
            default 0 if DW_LOG_APP_NONE
            default 1 if DW_LOG_APP_ERROR
            default 2 if DW_LOG_APP_WARN
            default 3 if DW_LOG_APP_INFO
            default 4 if DW_LOG_APP_DEBUG
    
        choice DW_LOG_BLE_LEVEL
            bool "BLE log verbosity"
            default DW_LOG_BLE_NONE
            help
                Specify how much output to see in BLE logs.
    
                Note that this setting limits which log statements
                are compiled into the program. So setting this to, say,
                "Warning" would mean that changing log level to "Debug"
                at runtime will not be possible.
    
            config DW_LOG_BLE_NONE
                bool "No output"
            config DW_LOG_BLE_ERROR
                bool "Error"
            config DW_LOG_BLE_WARN
                bool "Warning"
            config DW_LOG_BLE_INFO
                bool "Info"
            config DW_LOG_BLE_DEBUG
                bool "Debug"
        endchoice
        
        config DW_LOG_BLE_LEVEL
            int
            default 0 if DW_LOG_BLE_NONE
            default 1 if DW_LOG_BLE_ERROR
            default 2 if DW_LOG_BLE_WARN
            default 3 if DW_LOG_BLE_INFO
            default 4 if DW_LOG_BLE_DEBUG
    
        choice DW_LOG_SHCI_LEVEL
            bool "SHCI log verbosity"
            default DW_LOG_SHCI_NONE
            help
                Specify how much output to see in Serial Host Commnand
                Interface (SHCI) logs.
    
                Note that this setting limits which log statements
                are compiled into the program. So setting this to, say,
                "Warning" would mean that changing log level to "Debug"
                at runtime will not be possible.
    
            config DW_LOG_SHCI_NONE
                bool "No output"
            config DW_LOG_SHCI_ERROR
                bool "Error"
            config DW_LOG_SHCI_WARN
                bool "Warning"
            config DW_LOG_SHCI_INFO
                bool "Info"
            config DW_LOG_SHCI_DEBUG
                bool "Debug"
        endchoice
        
        config DW_LOG_SHCI_LEVEL
            int
            default 0 if DW_LOG_SHCI_NONE
            default 1 if DW_LOG_SHCI_ERROR
            default 2 if DW_LOG_SHCI_WARN
            default 3 if DW_LOG_SHCI_INFO
            default 4 if DW_LOG_SHCI_DEBUG
    
        choice DW_LOG_MQTT_LEVEL
            bool "MQTT log verbosity"
            default DW_LOG_MQTT_NONE
            help
                Specify how much output to see in MQTT logs.
    
                Note that this setting limits which log statements
                are compiled into the program. So setting this to, say,
                "Warning" would mean that changing log level to "Debug"
                at runtime will not be possible.
    
            config DW_LOG_MQTT_NONE
                bool "No output"
            config DW_LOG_MQTT_ERROR
                bool "Error"
            config DW_LOG_MQTT_WARN
                bool "Warning"
            config DW_LOG_MQTT_INFO
                bool "Info"
            config DW_LOG_MQTT_DEBUG
                bool "Debug"
        endchoice
        
        config DW_LOG_MQTT_LEVEL
            int
            default 0 if DW_LOG_MQTT_NONE
            default 1 if DW_LOG_MQTT_ERROR
            default 2 if DW_LOG_MQTT_WARN
            default 3 if DW_LOG_MQTT_INFO
            default 4 if DW_LOG_MQTT_DEBUG
    
        choice DW_LOG_NVS_LEVEL
            bool "NVS log verbosity"
            default DW_LOG_NVS_NONE
            help
                Specify how much output to see in NVS logs.
    
                Note that this setting limits which log statements
                are compiled into the program. So setting this to, say,
                "Warning" would mean that changing log level to "Debug"
                at runtime will not be possible.
    
            config DW_LOG_NVS_NONE
                bool "No output"
            config DW_LOG_NVS_ERROR
                bool "Error"
            config DW_LOG_NVS_WARN
                bool "Warning"
            config DW_LOG_NVS_INFO
                bool "Info"
            config DW_LOG_NVS_DEBUG
                bool "Debug"
        endchoice
        
        config DW_LOG_NVS_LEVEL
            int
            default 0 if DW_LOG_NVS_NONE
            default 1 if DW_LOG_NVS_ERROR
            default 2 if DW_LOG_NVS_WARN
            default 3 if DW_LOG_NVS_INFO
            default 4 if DW_LOG_NVS_DEBUG
            
        choice DW_LOG_SHADOW_LEVEL
            bool "Shadow log verbosity"
            default DW_LOG_SHADOW_NONE
            help
                Specify how much output to see in Shadow logs.
    
                Note that this setting limits which log statements
                are compiled into the program. So setting this to, say,
                "Warning" would mean that changing log level to "Debug"
                at runtime will not be possible.
    
            config DW_LOG_SHADOW_NONE
                bool "No output"
            config DW_LOG_SHADOW_ERROR
                bool "Error"
            config DW_LOG_SHADOW_WARN
                bool "Warning"
            config DW_LOG_SHADOW_INFO
                bool "Info"
            config DW_LOG_SHADOW_DEBUG
                bool "Debug"
        endchoice
        
        config DW_LOG_SHADOW_LEVEL
            int
            default 0 if DW_LOG_SHADOW_NONE
            default 1 if DW_LOG_SHADOW_ERROR
            default 2 if DW_LOG_SHADOW_WARN
            default 3 if DW_LOG_SHADOW_INFO
            default 4 if DW_LOG_SHADOW_DEBUG
    
        choice DW_LOG_CRED_LEVEL
            bool "Credential Storage log verbosity"
            default DW_LOG_CRED_NONE
            help
                Specify how much output to see in Credential Storage logs.
    
                Note that this setting limits which log statements
                are compiled into the program. So setting this to, say,
                "Warning" would mean that changing log level to "Debug"
                at runtime will not be possible.
    
            config DW_LOG_CRED_NONE
                bool "No output"
            config DW_LOG_CRED_ERROR
                bool "Error"
            config DW_LOG_CRED_WARN
                bool "Warning"
            config DW_LOG_CRED_INFO
                bool "Info"
            config DW_LOG_CRED_DEBUG
                bool "Debug"
        endchoice

        choice DW_LOG_TIMESYNC_LEVEL
            bool "TimeSync log verbosity"
            default DW_LOG_TIMESYNC_NONE
            help
                Specify how much output to see in TimeSync logs.
    
                Note that this setting limits which log statements
                are compiled into the program. So setting this to, say,
                "Warning" would mean that changing log level to "Debug"
                at runtime will not be possible.
    
            config DW_LOG_TIMESYNC_NONE
                bool "No output"
            config DW_LOG_TIMESYNC_ERROR
                bool "Error"
            config DW_LOG_TIMESYNC_WARN
                bool "Warning"
            config DW_LOG_STIMESYNC_INFO
                bool "Info"
            config DW_LOG_TIMESYNC_DEBUG
                bool "Debug"
        endchoice
        
        config DW_LOG_TIMESYNC_LEVEL
            int
            default 0 if DW_LOG_TIMESYNC_NONE
            default 1 if DW_LOG_TIMESYNC_ERROR
            default 2 if DW_LOG_TIMESYNC_WARN
            default 3 if DW_LOG_TIMESYNC_INFO
            default 4 if DW_LOG_TIMESYNC_DEBUG
    
        choice DW_LOG_EVENTRECORD_LEVEL
            bool "Event Record log verbosity"
            default DW_LOG_EVENTRECORD_NONE
            help
                Specify how much output to see in Event Record logs.
    
                Note that this setting limits which log statements
                are compiled into the program. So setting this to, say,
                "Warning" would mean that changing log level to "Debug"
                at runtime will not be possible.
    
            config DW_LOG_EVENTRECORD_NONE
                bool "No output"
            config DW_LOG_EVENTRECORD_ERROR
                bool "Error"
            config DW_LOG_EVENTRECORD_WARN
                bool "Warning"
            config DW_LOG_EVENTRECORD_INFO
                bool "Info"
            config DW_LOG_EVENTRECORD_DEBUG
                bool "Debug"
        endchoice
        
        config DW_LOG_EVENTRECORD_LEVEL
            int
            default 0 if DW_LOG_EVENTRECORD_NONE
            default 1 if DW_LOG_EVENTRECORD_ERROR
            default 2 if DW_LOG_EVENTRECORD_WARN
            default 3 if DW_LOG_EVENTRECORD_INFO
            default 4 if DW_LOG_EVENTRECORD_DEBUG
    
        choice DW_LOG_FLEET_PROVISIONING_LEVEL
            bool "Fleet Provisioning log verbosity"
            default DW_LOG_FLEET_PROVISIONING_NONE
            help
                Specify how much output to see in Fleet Provisioning logs.
    
                Note that this setting limits which log statements
                are compiled into the program. So setting this to, say,
                "Warning" would mean that changing log level to "Debug"
                at runtime will not be possible.
    
            config DW_LOG_FLEET_PROVISIONING_NONE
                bool "No output"
            config DW_LOG_FLEET_PROVISIONING_ERROR
                bool "Error"
            config DW_LOG_FLEET_PROVISIONING_WARN
                bool "Warning"
            config DW_LOG_FLEET_PROVISIONING_INFO
                bool "Info"
            config DW_LOG_FLEET_PROVISIONING_DEBUG
                bool "Debug"
        endchoice
        
        config DW_LOG_FLEET_PROVISIONING_LEVEL
            int
            default 0 if DW_LOG_FLEET_PROVISIONING_NONE
            default 1 if DW_LOG_FLEET_PROVISIONING_ERROR
            default 2 if DW_LOG_FLEET_PROVISIONING_WARN
            default 3 if DW_LOG_FLEET_PROVISIONING_INFO
            default 4 if DW_LOG_FLEET_PROVISIONING_DEBUG

        choice DW_LOG_OTAUPDATE_LEVEL
            bool "OTA Update log verbosity"
            default DW_LOG_OTAUPDATE_NONE
            help
                Specify how much output to see in OTA Update logs.
    
                Note that this setting limits which log statements
                are compiled into the program. So setting this to, say,
                "Warning" would mean that changing log level to "Debug"
                at runtime will not be possible.
    
            config DW_LOG_OTAUPDATE_NONE
                bool "No output"
            config DW_LOG_OTAUPDATE_ERROR
                bool "Error"
            config DW_LOG_OTAUPDATE_WARN
                bool "Warning"
            config DW_LOG_OTAUPDATE_INFO
                bool "Info"
            config DW_LOG_OTAUPDATE_DEBUG
                bool "Debug"
        endchoice
        
        config DW_LOG_OTAUPDATE_LEVEL
            int
            default 0 if DW_LOG_OTAUPDATE_NONE
            default 1 if DW_LOG_OTAUPDATE_ERROR
            default 2 if DW_LOG_OTAUPDATE_WARN
            default 3 if DW_LOG_OTAUPDATE_INFO
            default 4 if DW_LOG_OTAUPDATE_DEBUG
    
        choice DW_LOG_OTA_LEVEL
            bool "FreeRTOS OTA Agent log verbosity"
            default DW_LOG_OTA_NONE
            help
                Specify how much output to see in FreeRTOS OTA Agent logs.
    
                Level 1 has least verbose logging
                Level 3 has most verbose logging
    
            config DW_LOG_OTA_NONE
                bool "No output"
            config DW_LOG_OTA_L1
                bool "Level 1"
            config DW_LOG_OTA_L2
                bool "Level 2"
            config DW_LOG_OTA_L3
                bool "Level 3"
        endchoice
        
        config DW_LOG_OTA_LEVEL
            int
            default 0 if DW_LOG_OTA_NONE
            default 1 if DW_LOG_OTA_L1
            default 2 if DW_LOG_OTA_L2
            default 3 if DW_LOG_OTA_L3
            
        choice DW_LOG_IMG_PROCES_LEVEL
            bool "Image processing log verbosity"
            default DW_LOG_IMG_PROCES_NONE
            help
                Specify how much output to see in Image Processing logs.
    
                Note that this setting limits which log statements
                are compiled into the program. So setting this to, say,
                "Warning" would mean that changing log level to "Debug"
                at runtime will not be possible.
    
            config DW_LOG_IMG_PROCES_NONE
                bool "No output"
            config DW_LOG_IMG_PROCES_ERROR
                bool "Error"
            config DW_LOG_IMG_PROCES_WARN
                bool "Warning"
            config DW_LOG_IMG_PROCES_INFO
                bool "Info"
            config DW_LOG_IMG_PROCES_DEBUG
                bool "Debug"
        endchoice
        
        config DW_LOG_IMG_PROCES_LEVEL
            int
            default 0 if DW_LOG_IMG_PROCES_NONE
            default 1 if DW_LOG_IMG_PROCES_ERROR
            default 2 if DW_LOG_IMG_PROCES_WARN
            default 3 if DW_LOG_IMG_PROCES_INFO
            default 4 if DW_LOG_IMG_PROCES_DEBUG
            
        choice DW_LOG_HOSTOTA_LEVEL
            bool "Host OTA log verbosity"
            default DW_LOG_HOSTOTA_NONE
            help
                Specify how much output to see in Host OTA logs.
    
                Note that this setting limits which log statements
                are compiled into the program. So setting this to, say,
                "Warning" would mean that changing log level to "Debug"
                at runtime will not be possible.
    
            config DW_LOG_HOSTOTA_NONE
                bool "No output"
            config DW_LOG_HOSTOTA_ERROR
                bool "Error"
            config DW_LOG_HOSTOTA_WARN
                bool "Warning"
            config DW_LOG_HOSTOTA_INFO
                bool "Info"
            config DW_LOG_HOSTOTA_DEBUG
                bool "Debug"
        endchoice
        
        config DW_LOG_SYSPARAM_LEVEL
            int
            default 0 if DW_LOG_SYSPARAM_NONE
            default 1 if DW_LOG_SYSPARAM_ERROR
            default 2 if DW_LOG_SYSPARAM_WARN
            default 3 if DW_LOG_SYSPARAM_INFO
            default 4 if DW_LOG_SYSPARAM_DEBUG
 
        choice DW_LOG_SYSPARAM_LEVEL
            bool "System Parameter log verbosity"
            default DW_LOG_SYSPARAM_NONE
            help
                Specify how much output to see in System Parameter logs.
    
                Note that this setting limits which log statements
                are compiled into the program. So setting this to, say,
                "Warning" would mean that changing log level to "Debug"
                at runtime will not be possible.
    
            config DW_LOG_SYSPARAM_NONE
                bool "No output"
            config DW_LOG_SYSPARAM_ERROR
                bool "Error"
            config DW_LOG_SYSPARAM_WARN
                bool "Warning"
            config DW_LOG_SYSPARAM_INFO
                bool "Info"
            config DW_LOG_SYSPARAM_DEBUG
                bool "Debug"
        endchoice
        
        config DW_LOG_SYSPARAM_LEVEL
            int
            default 0 if DW_LOG_SYSPARAM_NONE
            default 1 if DW_LOG_SYSPARAM_ERROR
            default 2 if DW_LOG_SYSPARAM_WARN
            default 3 if DW_LOG_SYSPARAM_INFO
            default 4 if DW_LOG_SYSPARAM_DEBUG
 
    endmenu

endmenu # "Drinkworks Configuration"
```
